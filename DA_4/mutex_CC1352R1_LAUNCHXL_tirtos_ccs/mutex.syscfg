/**
 * @cliArgs --board "/ti/boards/CC1352R1_LAUNCHXL" --product "simplelink_cc13x2_26x2_sdk@5.20.00.52"
 * @versions {"data":"2021060817","timestamp":"2021060817","tool":"1.8.2+1992","templates":null}
 */

/**
 * Import the modules used in this configuration.
 */
const Display  = scripting.addModule("/ti/display/Display", {}, false);
const Display1 = Display.addInstance();
const ADC      = scripting.addModule("/ti/drivers/ADC", {}, false);
const ADC1     = ADC.addInstance();
const GPIO     = scripting.addModule("/ti/drivers/GPIO");
const GPIO1    = GPIO.addInstance();
const GPIO2    = GPIO.addInstance();
const GPIO3    = GPIO.addInstance();
const I2C      = scripting.addModule("/ti/drivers/I2C", {}, false);
const I2C1     = I2C.addInstance();
const PWM      = scripting.addModule("/ti/drivers/PWM", {}, false);
const PWM1     = PWM.addInstance();
const Power    = scripting.addModule("/ti/drivers/Power");
const RTOS     = scripting.addModule("/ti/drivers/RTOS");

/**
 * Write custom configuration values to the imported modules.
 */
Display1.$name                    = "CONFIG_Display_0";
Display1.$hardware                = system.deviceData.board.components.XDS110UART;
Display1.uart.$name               = "CONFIG_UART_0";
Display1.uart.txPinInstance.$name = "CONFIG_PIN_4";
Display1.uart.rxPinInstance.$name = "CONFIG_PIN_5";

ADC1.$name                = "CONFIG_ADC_0";
ADC1.adcPinInstance.$name = "CONFIG_PIN_1";

GPIO1.$name              = "CONFIG_GPIO_LED_0";
GPIO1.initialOutputState = "High";
GPIO1.pinInstance.$name  = "CONFIG_PIN_0";

GPIO2.$name             = "CONFIG_GPIO_0";
GPIO2.$hardware         = system.deviceData.board.components["BTN-1"];
GPIO2.callbackFunction  = "pushButton";
GPIO2.pinInstance.$name = "CONFIG_PIN_2";

GPIO3.$name             = "CONFIG_GPIO_LED_1";
GPIO3.$hardware         = system.deviceData.board.components.LED_GREEN;
GPIO3.outputStrength    = "High";
GPIO3.pinInstance.$name = "CONFIG_PIN_3";

I2C1.$name                = "CONFIG_I2C_0";
I2C1.i2c.sdaPin.$assign   = "boosterpack.10";
I2C1.i2c.sclPin.$assign   = "boosterpack.9";
I2C1.sdaPinInstance.$name = "CONFIG_PIN_6";
I2C1.clkPinInstance.$name = "CONFIG_PIN_7";

PWM1.$name                            = "CONFIG_PWM_0";
PWM1.$hardware                        = system.deviceData.board.components.LED_RED;
PWM1.timerObject.$name                = "CONFIG_GPTIMER_0";
PWM1.timerObject.pwmPinInstance.$name = "CONFIG_PIN_8";

const CCFG              = scripting.addModule("/ti/devices/CCFG", {}, false);
CCFG.ccfgTemplate.$name = "ti_devices_CCFGTemplate0";

/**
 * Pinmux solution for unlocked pins/peripherals. This ensures that minor changes to the automatic solver in a future
 * version of the tool will not impact the pinmux you originally saw.  These lines can be completely deleted in order to
 * re-solve from scratch.
 */
Display1.uart.uart.$suggestSolution            = "UART1";
Display1.uart.uart.txPin.$suggestSolution      = "boosterpack.4";
Display1.uart.uart.rxPin.$suggestSolution      = "boosterpack.3";
ADC1.adc.$suggestSolution                      = "ADC0";
ADC1.adc.adcPin.$suggestSolution               = "boosterpack.2";
GPIO1.gpioPin.$suggestSolution                 = "boosterpack.19";
GPIO2.gpioPin.$suggestSolution                 = "boosterpack.13";
GPIO3.gpioPin.$suggestSolution                 = "boosterpack.40";
I2C1.i2c.$suggestSolution                      = "I2C0";
PWM1.timerObject.timer.$suggestSolution        = "GPTM0";
PWM1.timerObject.timer.pwmPin.$suggestSolution = "boosterpack.39";
